## drivers/sensor/Kconfig
```kconfig
# Copyright (c) 2021 Nordic Semiconductor ASA
# SPDX-License-Identifier: Apache-2.0

if SENSOR
rsource "m080r/Kconfig"
endif # SENSOR
```

## drivers/sensor/m080r/Kconfig
```kconfig
# Copyright (c) 2021 Nordic Semiconductor ASA
# SPDX-License-Identifier: Apache-2.0

config M080R_SENSOR
	bool "M080R sensor"
	default y
	depends on DT_HAS_ZEPHYR_M080R_SENSOR_ENABLED
	select GPIO
	help
	  Enable M080R sensor
```

## m080r_driver_module/drivers/sensor/m080r/Kconfig
```kconfig
# Copyright (c) 2021 Nordic Semiconductor ASA
# SPDX-License-Identifier: Apache-2.0

config M080R
	bool "M080R sensor"
	default y
	depends on DT_HAS_CHINESE_M080R_ENABLED
	help
	  Enable M080R sensor
```

## m080r_driver_module/dts/bindings/sensor/chinese,m080r.yaml
```yaml
# Copyright (c) 2020 Nordic Semiconductor ASA
# SPDX-License-Identifier: Apache-2.0

description: |
  Chinese fingerprint sensor.  See more info at: kaz ro


compatible: "chinese,m080r"

include: sensor-device.yaml
properties:
  uart-node:
    type: phandle
    required: true
    description: |
      The uart used to communicate with the sensor.
  irq-gpios:
    type: phandle-array
    description: |
          The TOUCH_OUT and PWR_EN (PNP Transistor) signal connections.
```
