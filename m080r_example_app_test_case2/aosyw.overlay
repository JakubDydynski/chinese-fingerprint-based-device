
&uart1 {
    status = "okay";
    current-speed = <57600>;
};



/ {
	m080r0: m080r_0 {
		compatible = "chinese,m080r"; 
        uart-node = <&uart1>;
        irq-gpios = <&gpio1 10 (GPIO_PULL_DOWN | GPIO_ACTIVE_HIGH)>, <&gpio1 11 (GPIO_ACTIVE_LOW)>;
	};
    // buttons {
    //     button2: button_2 {
    //         gpios = <&gpio1 10 (GPIO_ACTIVE_HIGH)>;
    //         label = "Push button 3";
    //     };
    // };
};